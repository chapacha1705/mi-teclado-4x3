/ {
    chosen {
        zmk,kscan = &kscan0;
    };

    kscan0: kscan {
        compatible = "zmk,kscan-gpio-matrix";
        label = "KSCAN";
        diode-direction = "col2row";

        row-gpios
            = <&pro_micro 15 (GPIO_ACTIVE_HIGH | GPIO_PULL_DOWN)> // Fila 0
            , <&pro_micro 14 (GPIO_ACTIVE_HIGH | GPIO_PULL_DOWN)> // Fila 1
            , <&pro_micro 16 (GPIO_ACTIVE_HIGH | GPIO_PULL_DOWN)> // Fila 2
            , <&pro_micro 10 (GPIO_ACTIVE_HIGH | GPIO_PULL_DOWN)> // Fila 3
            ;

        col-gpios
            = <&pro_micro 18 GPIO_ACTIVE_HIGH> // Col 0
            , <&pro_micro 19 GPIO_ACTIVE_HIGH> // Col 1
            , <&pro_micro 20 GPIO_ACTIVE_HIGH> // Col 2
            ;
    };
};
